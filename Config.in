## Config.in
```kconfig
menu "Raspberry Pi 5 Customizations"
source "$BR2_EXTERNAL_BUILDROOT_PFS_PATH/package/brcmfmac-firmware/Config.in"
source "$BR2_EXTERNAL_BUILDROOT_PFS_PATH/package/rpi5_hardware_monitor/Config.in"
endmenu
```

## configs/raspberrypi5_defconfig
```kconfig
BR2_aarch64=y
BR2_cortex_a76=y
BR2_PACKAGE_HOST_LINUX_HEADERS_CUSTOM_6_6=y
BR2_TOOLCHAIN_BUILDROOT_CXX=y
BR2_DL_DIR="/var/buildroot/dl"
BR2_CCACHE=y
BR2_CCACHE_DIR="/var/buildroot/.buildroot-ccache"
BR2_GLOBAL_PATCH_DIR="board/raspberrypi/patches"
BR2_DOWNLOAD_FORCE_CHECK_HASHES=y
BR2_TARGET_GENERIC_ROOT_PASSWD="root"
BR2_SYSTEM_DHCP="eth0"
BR2_ROOTFS_OVERLAY="$(BR2_EXTERNAL_BUILDROOT_PFS_PATH)/board/raspberrypi5/rootfs_overlay"
BR2_ROOTFS_POST_BUILD_SCRIPT="$(BR2_EXTERNAL_BUILDROOT_PFS_PATH)/board/raspberrypi5/post-build.sh"
BR2_ROOTFS_POST_IMAGE_SCRIPT="$(BR2_EXTERNAL_BUILDROOT_PFS_PATH)/board/raspberrypi5/post-image.sh"
BR2_LINUX_KERNEL=y
BR2_LINUX_KERNEL_CUSTOM_TARBALL=y
BR2_LINUX_KERNEL_CUSTOM_TARBALL_LOCATION="$(call github,raspberrypi,linux,576cc10e1ed50a9eacffc7a05c796051d7343ea4)/linux-576cc10e1ed50a9eacffc7a05c796051d7343ea4.tar.gz"
BR2_LINUX_KERNEL_USE_CUSTOM_CONFIG=y
BR2_LINUX_KERNEL_CUSTOM_CONFIG_FILE="$(BR2_EXTERNAL_BUILDROOT_PFS_PATH)/board/raspberrypi5/linux.config"
BR2_LINUX_KERNEL_CONFIG_FRAGMENT_FILES="$(BR2_EXTERNAL_BUILDROOT_PFS_PATH)/board/raspberrypi5/linux-4k-page-size.fragment"
BR2_LINUX_KERNEL_DTS_SUPPORT=y
BR2_LINUX_KERNEL_CUSTOM_DTS_PATH="$(BR2_EXTERNAL_BUILDROOT_PFS_PATH)/board/raspberrypi5/dts/arm/bcm2712-rpi-5-b.dtsi $(BR2_EXTERNAL_BUILDROOT_PFS_PATH)/board/raspberrypi5/dts/arm/bcm2712-rpi.dtsi $(BR2_EXTERNAL_BUILDROOT_PFS_PATH)/board/raspberrypi5/dts/arm/bcm2712.dtsi $(BR2_EXTERNAL_BUILDROOT_PFS_PATH)/board/raspberrypi5/dts/arm/bcm2712d0-rpi-5-b.dtsi $(BR2_EXTERNAL_BUILDROOT_PFS_PATH)/board/raspberrypi5/dts/arm/rp1.dtsi $(BR2_EXTERNAL_BUILDROOT_PFS_PATH)/board/raspberrypi5/dts/arm64/bcm2712-rpi-5-b.dts $(BR2_EXTERNAL_BUILDROOT_PFS_PATH)/board/raspberrypi5/dts/arm64/bcm2712d0-rpi-5-b.dts"
BR2_LINUX_KERNEL_DTB_OVERLAY_SUPPORT=y
BR2_LINUX_KERNEL_NEEDS_HOST_OPENSSL=y
BR2_PACKAGE_BUSYBOX_CONFIG="$(BR2_EXTERNAL_BUILDROOT_PFS_PATH)/board/raspberrypi5/busybox.config"
BR2_PACKAGE_BUSYBOX_SHOW_OTHERS=y
BR2_PACKAGE_XZ=y
BR2_PACKAGE_RPI_FIRMWARE=y
BR2_PACKAGE_RPI_FIRMWARE_CONFIG_FILE="$(BR2_EXTERNAL_BUILDROOT_PFS_PATH)/board/raspberrypi5/configs/config.txt"
BR2_PACKAGE_RPI_FIRMWARE_CMDLINE_FILE="$(BR2_EXTERNAL_BUILDROOT_PFS_PATH)/board/raspberrypi5/configs/cmdline.txt"
# BR2_PACKAGE_RPI_FIRMWARE_INSTALL_DTB_OVERLAYS is not set
BR2_PACKAGE_LM_SENSORS=y
BR2_PACKAGE_LM_SENSORS_FANCONTROL=y
BR2_PACKAGE_OPENSSH=y
BR2_PACKAGE_KMOD=y
BR2_PACKAGE_KMOD_TOOLS=y
BR2_TARGET_ROOTFS_EXT2=y
BR2_TARGET_ROOTFS_EXT2_4=y
BR2_TARGET_ROOTFS_EXT2_SIZE="120M"
# BR2_TARGET_ROOTFS_TAR is not set
BR2_PACKAGE_HOST_DOSFSTOOLS=y
BR2_PACKAGE_HOST_GENIMAGE=y
BR2_PACKAGE_HOST_KMOD_XZ=y
BR2_PACKAGE_HOST_MTOOLS=y
```

## package/brcmfmac-firmware/Config.in
```kconfig
config BR2_PACKAGE_BRCMFMAC_FIRMWARE
  bool "BRCMFMAC FIrmware"
  default n
  help
    Download BRCFMAC firmware from linux kernel source
```

## package/rpi5_hardware_monitor/Config.in
```kconfig
config BR2_PACKAGE_RPI5_HARDWARE_MONITOR
  bool "RPI5 Hardware Monitor"
  default n
  help
    Use custom RPI5 hardware monitor to monitor CPU temperature
```
